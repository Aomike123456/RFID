/*********************************************************************
 * 实验名称：四线驱动1602液晶实验
*********************************************************************/
#include	"STC8H.h"				//主控芯片的头文件
/***************************常用数据类型定义*************************/
#define u8  uint8_t
#define u16 uint16_t
#define u32 uint32_t
typedef unsigned char  uint8_t;
typedef unsigned int   uint16_t;
typedef unsigned long  uint32_t;
/***************************端口/引脚定义区域************************/
sbit LCDRS=P3^6;     			//LCD1602数据/命令选择端口
sbit LCDEN=P3^7;     			//LCD1602使能信号端口
#define LCDDATA  P1  			//LCD1602数据端口（仅用DB4至DB7）
/***************************用户自定义数据区域***********************/
u8 table1[]="==SYS PASSWORD==";//LCD1602显示字符串数组1
u8 table2[]="****************";//LCD1602显示字符串数组2
/*****************************函数声明区域***************************/
void delay(u16 Count);		//延时函数
void IO_init(void);       //IO初始化函数
void LCD1602_Write(u8 cmdordata,u8 writetype);
//写入液晶模组命令或数据函数
void LCD1602_init(void);	//LCD1602初始化函数
void LCD1602_DIS(void);		//显示字符函数
/******************************主函数区域****************************/
void main(void)
{
	IO_init();				//IO初始化
	LCDEN=1;delay(200);//使能置“1”（防止复位乱码）
	LCDEN=0;delay(200);//使能清“0”（防止复位乱码）
	LCD1602_init(); 	//LCD1602初始化
	delay(200);				//延时等待稳定
  LCD1602_DIS();  	//显示字符效果
  while(1);					//程序死循环“停止”
}
/********************************************************************/
//延时函数delay()，有形参Count用于控制延时函数执行次数，无返回值
/********************************************************************/
void delay(u16 Count)
{
  u8 i,j;
  while(Count--)
  {
    for(i=0;i<50;i++)
      for(j=0;j<20;j++);
  }
}
/********************************************************************/
//IO初始化函数IO_Init()，无形参，无返回值
/********************************************************************/
void IO_init(void)
{
	//配置P3.6-7为准双向/弱上拉模式
	P3M0&=0x3F;			//P3M0.6-7=0
	P3M1&=0x3F;			//P3M1.6-7=0
	//配置P1.0-3为准双向/弱上拉模式
	P1M0&=0xF0;			//P1M0.0-3=0
	P1M1&=0xF0;			//P1M1.0-3=0
	delay(10);			//等待I/O模式配置稳定
}
/********************************************************************/
//LCD1602初始化函数LCD1602_init()，无形参和返回值
/********************************************************************/
void LCD1602_init(void)
{
	//写法1：*******************************************************
//	LCD1602_Write(0x32,0);delay(10);//0x32非命令，参见HD44780数据手册
//	LCD1602_Write(0x28,0);delay(10);//数据总线为4位，显示2行，5*7点阵/每字符
//	LCD1602_Write(0x0C,0);delay(10);//设置开显示，不显示光标
//	LCD1602_Write(0x06,0);delay(10);//写入新数据后显示屏整体不移动仅光标右移
//	LCD1602_Write(0x01,0);delay(10);//写入清屏命令
	//写法2：*******************************************************
	LCD1602_Write(0x28,0);delay(10);//数据总线为4位，显示2行，5*7点阵/每字符
	LCDEN=1;delay(10);							//使能置“1”
	LCDEN=0;delay(10);							//使能清“0”
	LCD1602_Write(0x0C,0);delay(10);//设置开显示，不显示光标
	LCD1602_Write(0x06,0);delay(10);//写入新数据后显示屏整体不移动仅光标右移
	LCD1602_Write(0x01,0);delay(10);//写入清屏命令
}
/********************************************************************/
//显示字符函数LCD1602_DIS()，无形参和返回值
/********************************************************************/
void LCD1602_DIS(void)
{
  u8 i;									//定义控制循环变量i
  LCD1602_Write(0x80,0);//选择第一行
	delay(5);							//延时等待1602稳定
  for(i=0;i<16;i++)
  {
      LCD1602_Write(table1[i],1);//写入table1[]内容
      delay(1);
  }
  LCD1602_Write(0xC0,0);//选择第二行
	delay(5);							//延时等待1602稳定
  for(i=0;i<16;i++)
  {
      LCD1602_Write(table2[i],1);//写入table2[]内容
      delay(200);
  }
}
/********************************************************************/
//写入液晶模组命令或数据函数LCD1602_Write()，有形参cmdordata
//和writetype，无返回值
/********************************************************************/
void LCD1602_Write(u8 cmdordata,u8 writetype)
{
	u8 temp=0;								//定义数据处理中间变量
	LCDRS=writetype;					//判断写入类型0为命令1为数据
	delay(2);									//延时等待稳定
	LCDDATA&=0xF0;						//清数据引脚
	temp=cmdordata>>4;				//高四位移到低四位
	LCDDATA|=temp&0x0F;				//写高四位
	LCDEN=1;delay(2);					//使能置“1”
	LCDEN=0;delay(2);					//使能清“0”
	LCDDATA&=0xF0;						//清数据引脚
	LCDDATA|=cmdordata&0x0F;	//写低四位
	LCDEN=1;delay(2);					//使能置“1”
	LCDEN=0;delay(2);					//使能清“0”
}