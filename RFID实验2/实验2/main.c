/*********************************************************************
 * 实验名称：四线驱动1602液晶实验
 * 芯片型号：STC8G1K08/17（微调后可移植至STC8A/F/C/G/H系列单片机）
 * 时钟说明：芯片内部11.0592MHz，在使用STC-ISP软件时需要先配置然后
 *           下载到单片机使得时钟配置生效。
 * 实验说明：断电前提下向开发板插入1602液晶模块，然后用USB线插入到
 Uart-USB接口给开发板供电，做好STC-ISP配置并下载程序，观察1602液晶
 的显示情况（第一行显示“==SYS PASSWORD==”，第二行显示*号进度条效果
 ），从而学习1602液晶串行四线驱动方法。
*********************************************************************/
#include	"STC8H.h"				//主控芯片的头文件
/***************************常用数据类型定义*************************/
#define u8  uint8_t
#define u16 uint16_t
#define u32 uint32_t
typedef unsigned char  uint8_t;
typedef unsigned int   uint16_t;
typedef unsigned long  uint32_t;
/***************************端口/引脚定义区域************************/
sbit LCDRS=P3^6;     			//LCD1602数据/命令选择端口
sbit LCDEN=P3^7;     			//LCD1602使能信号端口
#define LCDDATA  P1  			//LCD1602数据端口（仅用DB4至DB7）
/***************************用户自定义数据区域***********************/







/*****************************函数声明区域***************************/
void delay(u16 Count);		//延时函数
void IO_init(void);       //IO初始化函数
void LCD1602_Write(u8 cmdordata,u8 writetype);
//写入液晶模组命令或数据函数
void LCD1602_init(void);	//LCD1602初始化函数
void LCD1602_DIS(void);		//显示字符函数
/******************************主函数区域****************************/
void main(void)
{
	IO_init();				//IO初始化
	LCDEN=1;delay(200);//使能置“1”（防止复位乱码）
	LCDEN=0;delay(200);//使能清“0”（防止复位乱码）
	LCD1602_init(); 	//LCD1602初始化
	delay(200);				//延时等待稳定
  LCD1602_DIS();  	//显示字符效果
  while(1);					//程序死循环“停止”
}
/********************************************************************/
//延时函数delay()，有形参Count用于控制延时函数执行次数，无返回值
/********************************************************************/
void delay(u16 Count)
{
  u8 i,j;
  while(Count--)
  {
    for(i=0;i<50;i++)
      for(j=0;j<20;j++);
  }
}
/********************************************************************/
//IO初始化函数IO_Init()，无形参，无返回值
/********************************************************************/










/********************************************************************/
//LCD1602初始化函数LCD1602_init()，无形参和返回值
/********************************************************************/
void LCD1602_init(void)
{
	
	
	
	
	
	
	

}
/********************************************************************/
//显示字符函数LCD1602_DIS()，无形参和返回值
/********************************************************************/
void LCD1602_DIS(void)
{

	
	
	
	
	
	
	

}
/********************************************************************/
//写入液晶模组命令或数据函数LCD1602_Write()，有形参cmdordata
//和writetype，无返回值
/********************************************************************/
void LCD1602_Write(u8 cmdordata,u8 writetype)
{

	
	
	
	
	
	
	
	
	
	
	
	
}