/******************************************************************/
#include	"STC8G.h"				//主控芯片的头文件
/************************常用数据类型定义*************************/
#define u8  uint8_t
#define u16 uint16_t
#define u32 uint32_t
typedef unsigned char    uint8_t;
typedef unsigned int     uint16_t;
typedef unsigned long    uint32_t;
/************************端口/引脚定义区域************************/
sbit KEY1=P3^4;           //按键1 
sbit KEY2=P3^3;           //按键2
/************************用户自定义数据区域***********************/
#define FOSC 11059200UL   //系统外部时钟频率（无符号长整型）
#define BAUD 9600         //欲配置的串口通信波特率值
/**************************函数声明区域***************************/
void delay(u16 Count);		//延时函数
void IO_init(void);   		//IO初始化函数
void UART_init(void);			//串口初始化函数
void SendData(u8 dat);		//串口发送单字节数据函数
void SendString(u8 *s);		//串口发送字符串函数
/***************************主函数区域****************************/





/****************************************************************/
//延时函数delay()，有形参Count用于控制延时函数执行次数，无返回值
/****************************************************************/
void delay(u16 Count)
{
  u8 i,j;
  while (Count--)
  {
    for(i=0;i<50;i++)
      for(j=0;j<20;j++);
  }
}
/****************************************************************/
//IO初始化函数IO_Init()，无形参，无返回值
/****************************************************************/
void IO_init(void)
{
	//配置P3.3-4为准双向/弱上拉模式
	P3M0&=0xE7;			//P3M0.3-4=0
	P3M1&=0xE7;			//P3M1.3-4=0
	delay(10);			//等待I/O模式配置稳定
}
/****************************************************************/
//串口初始化函数UART_init()，无形参，无返回值
/****************************************************************/


/****************************************************************/
//串口发送单字节数据SendData()，有形参dat用于接收欲发送的单字节
//数据，无返回值
/****************************************************************/





/****************************************************************/
//串口发送字符串函数SendString()，有形参*s属于指针变量，用于指向
//要发送的字符串首字节，通过指针的自增，逐一取出字符依次发送直至
//字符串结束标志'\0',无返回值
/****************************************************************/




