/*********************************************************************
 * 实验名称：键控OTP语音芯片播报实验
 * 可配书籍：上册-《深入浅出STC8增强型51单片机进阶攻略》已经出版
						 下册-《深入浅出STC8增强型51单片机实战攻略》还在写作
 * 书籍备注：龙顺宇编著 清华大学出版社出版
 * 淘宝店铺：https://520mcu.taobao.com/
 * 实验平台：思修电子工作室SX-RFID-B低频ID识别与应用开发板 Long
 * 芯片型号：STC8G1K08/17（微调后可移植至STC8A/F/C/G/H系列单片机）
 * 时钟说明：芯片内部11.0592MHz，在使用STC-ISP软件时需要先配置
						 然后下载到单片机使得时钟配置生效。
 * 实验说明：用USB线插入到Uart-USB接口给开发板供电，做好STC-ISP配置并
 下载程序，按下K1按键后语音芯片播报“滴，欢迎使用思修电子射频识别开发
 板”，按下K2按键后语音芯片播报“滴，刷卡成功，十位卡号为：2022123456”，
 以此学习OTP语音芯片操作方法及驱动程序的编写。
*********************************************************************/
#include 	"STC8H.h"				//主控芯片的头文件
#include  "intrins.h"			//因为要用到nop()函数故而包含此文件
/***************************常用数据类型定义*************************/
#define u8  uint8_t
#define u16 uint16_t
#define u32 uint32_t
typedef unsigned char  uint8_t;
typedef unsigned int   uint16_t;
typedef unsigned long  uint32_t;
/***************************端口/引脚定义区域************************/
sbit KEY1=P3^4;           //按键1 
sbit KEY2=P3^3;           //按键2
sbit ROTP=P1^7;						//OTP语音芯片复位脚
sbit DATA=P1^5;						//OTP语音芯片数据脚
sbit BUSY=P1^4;						//OTP语音芯片判忙脚
/***************************用户自定义数据区域***********************/
/*1:不放内容，2:滴（音效），3:错误提示音（音效），4:欢迎使用思修
电子射频识别开发板，5:模拟门禁模式，6:模拟公交模式，7:刷卡成功，
8:十位卡号为，9:八位卡号为，10:0，11:1，12:2，13:3，14:4，15:5，
16:6，17:7，18:8，19:9，20:管理卡，21:用户卡，22:学生卡，23:老年
卡，24:卡片有效，解锁成功，25:卡片非法，解锁失败，26:按键，27:识
别成功，28:扣费成功，29:免费乘车*/
/*****************************函数声明区域***************************/
void delay(u16 Count);		//延时函数
void Delay150us(void);		//150us延时函数
void IO_init(void);       //IO初始化函数
void KEY_Prosser(void);   //按键处理函数
void TTS(u8 num);					//OTP语音合成函数
/******************************主函数区域****************************/
void main(void)
{
	IO_init();							//IO初始化
	while(1)	
	{
		KEY_Prosser();				//按键处理
	}
}
/********************************************************************/
//延时函数delay()，有形参Count用于控制延时函数执行次数，无返回值
/********************************************************************/
void delay(u16 Count)
{
  u8 i,j;
  while(Count--)
  {
    for(i=0;i<50;i++)
      for(j=0;j<20;j++);
  }
}
/********************************************************************/
//150us延时函数Delay150us()，无形参，无返回值，这是用STC-ISP算出
//来的150us延时，此延时可以不严格，但应大于50us小于200us
/********************************************************************/
void Delay150us(void)//@11.0592MHz
{
	u8 i,j;
	_nop_();
	_nop_();
	i=3;
	j=36;
	do
	{
		while(--j);
	} while(--i);
}
/********************************************************************/
//IO初始化函数IO_Init()，无形参，无返回值
/********************************************************************/
void IO_init(void)
{
	//配置P3.3-4为准双向/弱上拉模式
	P3M0&=0xE7;			//P3M0.3-4=0
	P3M1&=0xE7;			//P3M1.3-4=0
	//配置P1.4为准双向/弱上拉模式
	P1M0&=0xEF;			//P1M0.4=0
	P1M1&=0xEF;			//P1M1.4=0
	//配置P1.5为推挽输出模式
	P1M0|=0x20;			//P1M0.5=1
	P1M1&=0xDF;			//P1M1.5=0
	//配置P1.7为推挽输出模式
	P1M0|=0x80;			//P1M0.7=1
	P1M1&=0x7F;			//P1M1.7=0
	delay(10);			//等待I/O模式配置稳定
	ROTP=1;					//拉高复位引脚
	DATA=1;					//拉高数据引脚
}
/********************************************************************/
//按键处理函数KEY_Prosser(),无形参，无返回值
/********************************************************************/
/*1:不放内容，2:滴（音效），3:错误提示音（音效），4:欢迎使用思修
电子射频识别开发板，5:模拟门禁模式，6:模拟公交模式，7:刷卡成功，
8:十位卡号为，9:八位卡号为，10:0，11:1，12:2，13:3，14:4，15:5，
16:6，17:7，18:8，19:9，20:管理卡，21:用户卡，22:学生卡，23:老年
卡，24:卡片有效，解锁成功，25:卡片非法，解锁失败，26:按键，27:识
别成功，28:扣费成功，29:免费乘车*/
/********************************************************************/
void KEY_Prosser(void)
{
	if(KEY1==0)			//KEY1按下了
	{
		delay(5);			//软件延时“消抖”
		if(KEY1==0)		//KEY1确实按下了
		{
			//合成语音“滴，欢迎使用思修电子射频识别开发板”
			TTS(1);while(!BUSY);		//播报1段并等待完成（无内容）
			TTS(2);while(!BUSY);		//播报2段并等待完成（滴）
			TTS(4);while(!BUSY);		//播报9段并等待完成（欢迎使用思修电子射频识别开发板）
		}
		while(!KEY1);	//松手检测
	}
	if(KEY2==0)			//KEY2按下了
	{
		delay(5);			//软件延时“消抖”
		if(KEY2==0)		//KEY2确实按下了
		{
			//合成语音“滴，刷卡成功，十位卡号为：2022123456”
			TTS(1);while(!BUSY);		//播报1段并等待完成（无内容）
			TTS(2);while(!BUSY);		//播报2段并等待完成（滴）
			TTS(7);while(!BUSY);		//播报7段并等待完成（刷卡成功）
			TTS(8);while(!BUSY);		//播报8段并等待完成（十位卡号为）
			TTS(12);while(!BUSY);		//播报12段并等待完成（2）
			TTS(10);while(!BUSY);		//播报10段并等待完成（0）
			TTS(12);while(!BUSY);		//播报12段并等待完成（2）
			TTS(12);while(!BUSY);		//播报12段并等待完成（2）
			TTS(11);while(!BUSY);		//播报11段并等待完成（1）
			TTS(12);while(!BUSY);		//播报12段并等待完成（2）
			TTS(13);while(!BUSY);		//播报13段并等待完成（3）
			TTS(14);while(!BUSY);		//播报14段并等待完成（4）
			TTS(15);while(!BUSY);		//播报15段并等待完成（5）
			TTS(16);while(!BUSY);		//播报16段并等待完成（6）
		}
		while(!KEY2);	//松手检测
	} 
}
/********************************************************************/
//OTP语音合成函数TTS_Prosser(),无形参，无返回值
/********************************************************************/
void TTS(u8 num)
{
	ROTP=1;					//拉高复位引脚
	Delay150us();		//保持150us
	ROTP=0;					//拉低复位引脚
	Delay150us();		//保持150us
	ROTP=1;					//拉高复位引脚
	Delay150us();		//保持150us
	ROTP=0;					//拉低复位引脚
	Delay150us();		//保持150us
	while(num>0)		//若选定播放段地址不为0，则正常播报
	{
		DATA=1;				//拉高数据引脚
		Delay150us();	//保持150us
		DATA=0;				//拉高数据引脚
		Delay150us();	//保持150us
		num--;				//发出num个脉冲指定要播报的段
	}
}
